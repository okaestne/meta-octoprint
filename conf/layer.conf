## conf/layer.conf
```bitbake
# We might have a conf and classes directory, append to BBPATH
BBPATH .= ":${LAYERDIR}"

# We have recipes directories, add to BBFILES
BBFILES += "${LAYERDIR}/recipes*/*/*.bb ${LAYERDIR}/recipes*/*/*.bbappend"

BBFILE_COLLECTIONS += "meta-octoprint"
BBFILE_PATTERN_meta-octoprint := "^${LAYERDIR}/"
BBFILE_PRIORITY_meta-octoprint = "100"

BBFILES_DYNAMIC += " \
    sunxi:${LAYERDIR}/dynamic-layers/sunxi/*/*/*.bb \
    sunxi:${LAYERDIR}/dynamic-layers/sunxi/*/*/*.bbappend \
"

LAYERSERIES_COMPAT_meta-octoprint = "mickledore"

LAYERDEPENDS_meta-octoprint = " \
    core \
    meta-python \
    openembedded-layer \
    perl-layer \
    webserver \
"
```
